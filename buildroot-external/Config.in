## buildroot-external/Config.in
```kconfig
menu "Network project packages"
	source "$BR2_EXTERNAL_NETWORK_PROJECT_PATH/package/network-app/Config.in"
endmenu
```

## buildroot-external/package/network-app/Config.in
```kconfig
config BR2_PACKAGE_NETWORK_APP
	bool "network-app"
	help
	  Example external package for network project integration.
```
